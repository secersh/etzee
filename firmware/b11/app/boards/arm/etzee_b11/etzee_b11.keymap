#include <behaviors.dtsi>
#include <dt-bindings/zmk/keys.h>

/ {
    keymap {
        compatible = "zmk,keymap";

        default_layer {
            bindings = <
  &kp Q
            >;
        };
    };
};
//        default_layer {
//            display-name = "Base layer";
//            bindings = <
//  &kp ESC   &kp Q &kp W     &kp E    &kp R    &kp T         &kp Y       &kp U   &kp I     &kp O   &kp P    &kp BSCP
//  &kp TAB   &kp A &kp S     &kp D    &kp F    &kp G         &kp H       &kp J   &kp K     &kp L   &kp SEMI &kp SQT
//  &kp LSHFT &kp Z &kp X     &kp C    &kp V    &kp B         &kp N       &kp M   &kp COMMA &kp DOT &kp FSLH &kp RSHFT
//                  &kp LCTRL &kp LALT &kp LGUI &lt 1 SPACE   &lt 2 SPACE &kp RET &mo 1     &mo 2
//            >;
//        };
//
//        left_space_layer {
//            display-name = "Left space raise layer";
//            bindings = <
//  &kp N1     &kp N2 &kp N3     &kp N4    &kp N5    &kp N6         &kp N7       &kp N8    &kp N9   &kp N0     &kp MINUS &kp EQUAL
//  &kp GRAVE &none &none     &none    &none    &none         &kp PG_UP   &kp HOME &kp END &kp LBKT  &kp RBKT  &kp BSLH 
//  &kp LSHFT &none &none     &none    &none    &none         &kp PG_DN   &none    &none   &none     &none     &kp RSHFT
//                  &kp LCTRL &kp LALT &kp LGUI &lt 1 SPACE   &lt 2 SPACE &kp RET  &mo FN1 &mo FN2
//            >;
//        };
//
//        right_space_layer {
//            display-name = "Right space raise layer";
//            bindings = <
//  &kp F1       &kp F2       &kp F3       &kp F4     &kp F5   &kp F6        &kp F7     &kp F8   &kp F9  &kp F10   &kp F11 &kp F12
//  &bt BT_SEL 0 &bt BT_SEL 1 &bt BT_SEL 2 &bt BT_CLR &bl BL_DEC  &bl BL_INC       &kp LEFT   &kp DOWN &kp UP  &kp RIGHT &none   &none
//  &none        &none        &none        &none      &none    &none         &none      &none    &none   &none     &none   &none
//                            &kp LCTRL    &kp LALT   &kp LGUI &lt 1 SPACE   &lt 2 SPACE &kp RET &mo FN1 &mo FN2
//            >;
//        };
//    };
//};
