## firmware/b11/app/boards/arm/etzee_b11/Kconfig
```kconfig
config IS_ORIGIN
    bool "Is this the origin side of a split keyboard?"

config IS_TERMINAL
    bool "Is this the terminal side of a split keyboard?"
```

## firmware/b11/app/boards/arm/etzee_b11/Kconfig.board
```kconfig
config BOARD_ETZEE_B11
    bool "etzee b11 split keyboard"
    depends on SOC_NRF52840_QIAA
```

## firmware/b11/app/src/htoyto/Kconfig
```kconfig
# htoyto UART protocol - configuration options

menuconfig HTOYTO_ENABLED
    bool "Enable htoyto protocol"
    default y
    select UART_ASYNC_API
    help
      Enables the etzee htoyto protocol for UART-based inter-module communication.

if HTOYTO_ENABLED

config HTOYTO_DEBOUNCE_MS
    int "dR line debounce delay in milliseconds"
    default 20
    help
      How long to wait after a dR GPIO edge before sampling the pin state.
      Filters mechanical bounce on the pogo pin connection.

config HTOYTO_UART_RX_TIMEOUT_MS
    int "UART RX idle timeout in milliseconds"
    default 5
    help
      How long after the last received byte before flushing the async DMA
      buffer. Must be short enough that multiple handshake round-trips fit
      within HTOYTO_HANDSHAKE_TIMEOUT_MS. At 115200 baud a full frame takes
      ~2 ms, so 5 ms gives ample margin without adding perceivable latency.

config HTOYTO_HANDSHAKE_TIMEOUT_MS
    int "Handshake timeout in milliseconds"
    default 200
    help
      Timeout between HLO, IAM, and EST frames before considering handshake failed.

config HTOYTO_MAX_NODE_ID_LENGTH
    int "Maximum length of node ID string"
    default 16
    help
      Maximum number of characters used to identify each htoyto node.

endif # HTOYTO_ENABLED
```

## firmware/b11/kbs/west.yml
```yaml
manifest:
  remotes:
    - name: zmkfirmware
      url-base: https://github.com/zmkfirmware
  projects:
    - name: zmk
      remote: zmkfirmware
      revision: main
      path: zmk
      import: app/west.yml
  self:
    path: .
```

## firmware/ws-1/app/boards/arm/etzee_101/Kconfig
```kconfig
config IS_CENTRAL
    bool "Is this the central side of a split keyboard?"

config IS_PERIPHERAL
    bool "Is this the peripheral side of a split keyboard?"
```

## firmware/ws-1/app/boards/arm/etzee_101/Kconfig.board
```kconfig
config BOARD_ETZEE_101
    bool "etzee 101 split keyboard"
    depends on SOC_NRF52840_QIAA
```

## firmware/ws-1/app/boards/arm/etzee_101/Kconfig.defconfig
```kconfig
if BOARD_ETZEE_101

config ZMK_SPLIT
    default y

if IS_ORIGIN

    config ZMK_KEYBOARD_NAME
        default "etzee 101"

    config ZMK_SPLIT_ROLE_CENTRAL
        default y

endif # IS_ORIGIN

if IS_TERMINAL

# empty for now

endif # IS_TERMINAL

endif # BOARD_ETZEE_101
```

## firmware/ws-1/app/boards/arm/etzee_101/etzee_101_defconfig
```kconfig
CONFIG_SOC_SERIES_NRF52X=y
CONFIG_SOC_NRF52840_QIAA=y
CONFIG_BOARD_ETZEE_101=y

CONFIG_ARM_MPU=y

CONFIG_USE_DT_CODE_PARTITION=y
CONFIG_BUILD_OUTPUT_UF2=y

CONFIG_MPU_ALLOW_FLASH_WRITE=y
CONFIG_NVS=y
CONFIG_SETTINGS_NVS=y
CONFIG_FLASH=y
CONFIG_FLASH_PAGE_LAYOUT=y
CONFIG_FLASH_MAP=y

#CONFIG_FLASH_LOAD_OFFSET=0x26000
#CONFIG_FLASH_LOAD_SIZE=0xC6000

CONFIG_GPIO=y

CONFIG_ZMK_USB=y
CONFIG_ZMK_BLE=y

# CONFIG_BT_UART=n
CONFIG_BT=y
CONFIG_BT_PERIPHERAL=y
CONFIG_BT_HCI=y
CONFIG_BT_CTLR=y
CONFIG_ZMK_BLE_CLEAR_BONDS_ON_START=y
CONFIG_ZMK_SETTINGS_RESET_ON_START=y

CONFIG_LOG_PROCESS_THREAD_STARTUP_DELAY_MS=8000
# CONFIG_ZMK_USB_LOGGING=y

# CONFIG_NRF_STORE_REBOOT_TYPE_GPREGRET=n
```

## firmware/ws-1/app/dts/bindings/htoyto/htoyto.yaml
```yaml
description: >
  etzee htoyto-zmk is a UART-based inter-module communication protocol
  designed for daisy-chained split keyboards. It uses rising edge interrupt
  to initiate a handshake between connected modules.

compatible: "etzee,htoyto-zmk"

include: base.yaml

properties:
  uart:
    type: phandle
    required: true
    description: UART device used for htoyto communication

  dr-gpios:
    type: phandle-array
    required: false
    description: >
      GPIO pin used for rising edge interrupt (dR line).
      Required only for origin and bridge roles.
      Although only one pin is used, Zephyr requires 'gpios' to be plural
      because the property value is a structured array of controller, pin, and flags.

  role:
    type: string
    required: true
    enum:
      - origin
      - bridge
      - terminal
    description: >
      Role of the htoyto node:
        - origin: initiates communication (left-facing connection)
        - bridge: forwards from left to right (middle node)
        - terminal: receives commands (right-facing connection)

  label:
    type: string
    required: false
    description: Logical label for identifying this htoyto device

  node-id:
    type: string
    required: true
    description: >
      A unique identifier for the node in the htoyto network.
      Used to route or trigger logic based on physical orientation or connection topology.
```
